/*********************************************************************************************************
* 模块名称：Timer.c
* 摘    要：Timer模块
* 当前版本：1.0.0
* 作    者：SZLY(COPYRIGHT 2018 - 2020 SZLY. All rights reserved.)
* 完成日期：2020年01月01日  
* 内    容：
* 注    意：                                                                  
**********************************************************************************************************
* 取代版本：
* 作    者：
* 完成日期：
* 修改内容：
* 修改文件：
*********************************************************************************************************/

/*********************************************************************************************************
*                                              包含头文件
*********************************************************************************************************/
#include "Timer.h"

/*********************************************************************************************************
*                                              宏定义
*********************************************************************************************************/

/*********************************************************************************************************
*                                              枚举结构体定义
*********************************************************************************************************/

/*********************************************************************************************************
*                                              内部变量
*********************************************************************************************************/
 static u8 s_i2msFlag = FALSE;
 static u8 s_i1secFlag = FALSE;
/*********************************************************************************************************
*                                              内部函数声明
*********************************************************************************************************/
static void ConfigTimer2(u16 arr, u16 psc);
static void ConfigTimer4(u16 arr, u16 psc);

/*********************************************************************************************************
*                                              内部函数实现
*********************************************************************************************************/
/*********************************************************************************************************
* 函数名称：ConfigTimer2
* 函数功能：定时器2配置
* 输入参数：void
* 输出参数：void
* 返 回 值：void
* 创建日期：2018年01月01日
* 注    意：none
*********************************************************************************************************/

static void ConfigTimer2(u16 arr, u16 psc){
  NVIC_InitTypeDef NVIC_InitStructure;//定义结构体
  TIM_TimeBaseInitTypeDef TIM_TimeBaseInitStructure;
  //使能外设时钟
  RCC_APB1PeriphClockCmd(RCC_APB1Periph_TIM2, ENABLE);
  //使用内部时钟
//  TIM_InternalClockConfig(TIM2);
  
  //配置定时器
  TIM_TimeBaseInitStructure.TIM_ClockDivision = TIM_CKD_DIV1;
  TIM_TimeBaseInitStructure.TIM_CounterMode = TIM_CounterMode_Up;
  TIM_TimeBaseInitStructure.TIM_Period = arr;
  TIM_TimeBaseInitStructure.TIM_Prescaler = psc;
  TIM_TimeBaseInitStructure.TIM_RepetitionCounter = 0;
  TIM_TimeBaseInit(TIM2, &TIM_TimeBaseInitStructure);
  //配置更新中断
  TIM_ITConfig(TIM2, TIM_IT_Update, ENABLE);
  
  //配置NVIC
  NVIC_InitStructure.NVIC_IRQChannel = TIM2_IRQn;
  NVIC_InitStructure.NVIC_IRQChannelCmd = ENABLE;
  NVIC_InitStructure.NVIC_IRQChannelPreemptionPriority = 1;
  NVIC_InitStructure.NVIC_IRQChannelSubPriority = 1;
  NVIC_Init(&NVIC_InitStructure);
  //开启时钟
  TIM_Cmd(TIM2, ENABLE);

}

/*********************************************************************************************************
* 函数名称：ConfigTimer5
* 函数功能：定时器5配置
* 输入参数：void
* 输出参数：void
* 返 回 值：void
* 创建日期：2018年01月01日
* 注    意：none
*********************************************************************************************************/


static void ConfigTimer4(u16 arr, u16 psc){
  //定义存放参数的结构体
  TIM_TimeBaseInitTypeDef TIM_TimeBaseInitStructure;
  NVIC_InitTypeDef NVIC_InitStructure;
  //使能外设时钟
  RCC_APB1PeriphClockCmd(RCC_APB1Periph_TIM4, ENABLE);
  //使用内部时钟
//  TIM_InternalClockConfig(TIM4);
  
  //配置定时器
  TIM_TimeBaseInitStructure.TIM_ClockDivision = TIM_CKD_DIV1;
  TIM_TimeBaseInitStructure.TIM_CounterMode = TIM_CounterMode_Up;
  TIM_TimeBaseInitStructure.TIM_Period = arr;
  TIM_TimeBaseInitStructure.TIM_Prescaler = psc;
  TIM_TimeBaseInitStructure.TIM_RepetitionCounter = 0;
  TIM_TimeBaseInit(TIM4, &TIM_TimeBaseInitStructure);
  //配置更新中断
  TIM_ITConfig(TIM4, TIM_IT_Update, ENABLE);
  
  //配置NVIC
  NVIC_InitStructure.NVIC_IRQChannel = TIM4_IRQn;
  NVIC_InitStructure.NVIC_IRQChannelCmd = ENABLE;
  NVIC_InitStructure.NVIC_IRQChannelPreemptionPriority = 1;
  NVIC_InitStructure.NVIC_IRQChannelSubPriority = 1;
  NVIC_Init(&NVIC_InitStructure);
  //开启定时器
  TIM_Cmd(TIM4, ENABLE);
  
}

/*********************************************************************************************************
* 函数名称：TIM2_IRQHandler
* 函数功能：定时器2中断服务
* 输入参数：void
* 输出参数：void
* 返 回 值：void
* 创建日期：2018年01月01日
* 注    意：none
*********************************************************************************************************/


void TIM2_IRQHandler(void){
  static u8 s_ccnt = 0; 
  if(TIM_GetITStatus(TIM2, TIM_IT_Update) == SET){//判断更新中断
    s_ccnt++;
    if(s_ccnt >= 2){//判断2ms
      s_ccnt = 0;
      s_i2msFlag = TRUE;//置2ms标志位
    }
    TIM_ClearITPendingBit(TIM2, TIM_IT_Update);//清除更新中断标志
  }
  
}

/*********************************************************************************************************
* 函数名称：TIM4_IRQHandler
* 函数功能：定时器5中断服务
* 输入参数：void
* 输出参数：void
* 返 回 值：void
* 创建日期：2018年01月01日
* 注    意：none
*********************************************************************************************************/


void TIM4_IRQHandler(void){ 
  if(TIM_GetITStatus(TIM4, TIM_IT_Update) == SET){//判定为更新中断
      s_i1secFlag = TRUE;//置1s标志位
  TIM_ClearITPendingBit(TIM4, TIM_IT_Update);//清除更新中断标志位
  }
}
/*********************************************************************************************************
*                                              API函数实现
*********************************************************************************************************/
/*********************************************************************************************************
* 函数名称：Timer_Init
* 函数功能：定时器初始化
* 输入参数：void
* 输出参数：void
* 返 回 值：void
* 创建日期：2018年01月01日
* 注    意：none
*********************************************************************************************************/

void Timer_Init(void){
  ConfigTimer2(999, 71);    //ARR = 999 PSC = 71 -> 频率 72 000 000 / （71 + 1） / （999 + 1）-> 1000Hz 周期1ms
  ConfigTimer4(9999, 7199); // 频率 1Hz 周期1s
}

/*********************************************************************************************************
* 函数名称：Timer_Get1secFlag
* 函数功能：获得1s标志位
* 输入参数：void
* 输出参数：void
* 返 回 值：s_i1secFlag 1s标志位 0 1
* 创建日期：2018年01月01日
* 注    意：none
*********************************************************************************************************/


u8 Timer_Get1secFlag(void){
  return s_i1secFlag;
}

/*********************************************************************************************************
* 函数名称：Timer_Clr1secFlag
* 函数功能：清除1s标志位
* 输入参数：void
* 输出参数：void
* 返 回 值：void
* 创建日期：2018年01月01日
* 注    意：none
*********************************************************************************************************/

void Timer_Clr1secFlag(void){
  s_i1secFlag = FALSE;
}

/*********************************************************************************************************
* 函数名称：Timer_Get2msFlag
* 函数功能：获得2ms标志位
* 输入参数：void
* 输出参数：void
* 返 回 值：s_i2msFlag 2ms标志位 0 1
* 创建日期：2018年01月01日
* 注    意：none
*********************************************************************************************************/

u8 Timer_Get2msFlag(void){
  return s_i2msFlag;
}

/*********************************************************************************************************
* 函数名称：Timer_Clr2msFlag
* 函数功能：清除2ms标志位
* 输入参数：void
* 输出参数：void
* 返 回 值：void
* 创建日期：2018年01月01日
* 注    意：none
*********************************************************************************************************/

void Timer_Clr2msFlag(void){
  s_i2msFlag = FALSE;
}

/*********************************************************************************************************
处理2ms任务    
void Proc2msTask(){
  if(Timer_Get2msFlag()){//判断标志位
    
    Timer_Clr2msFlag();//清除标志位
  }
}
处理1s任务     
void Proc1sTask(){
  if(Timer_Get1secFlag()){//判断标志位

    Timer_Clr1secFlag();//清除标志位
  }
}

注:     
        1 在主函数调用，起到延迟判断的作用，某些外设运行需要时间，单片机运行速度快不能一直指挥外设。
        2 标志位的使用在外设中是常用的，统一标准好理解与操作。
        3 设内部变量再用函数导出，此技巧在工程时就可以将每个模块的内部变量调出，而不用设全局变量搞乱。 
**********************************************************************************************************/
