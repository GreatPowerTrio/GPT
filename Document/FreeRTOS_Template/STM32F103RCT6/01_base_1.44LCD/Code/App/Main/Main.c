/*********************************************************************************************************
* 模块名称: 
* 摘 要: 
* 当前版本: 1.0.0
* 作 者: XXX
* 完成日期: 20XX 年 XX 月 XX 日
* 内 容:
* 注 意: none
**********************************************************************************************************
* 取代版本:
* 作 者:
* 完成日期:
* 修改内容:
* 修改文件:
*********************************************************************************************************/
 
 
/*********************************************************************************************************
* 包含头文件
*********************************************************************************************************/
#include "Config.h"
#include "FreeRTOS_Task.h"
/*********************************************************************************************************
* 宏定义
*********************************************************************************************************/


/*********************************************************************************************************
* 枚举结构体定义
*********************************************************************************************************/


/*********************************************************************************************************
* 内部变量
*********************************************************************************************************/


/*********************************************************************************************************
* 内部函数声明
*********************************************************************************************************/

static void InitHardware(void);
static void InitSoftware(void);
static void Proc2msTask(void);
static void Proc1secTask(void);
/*********************************************************************************************************
* 内部函数实现
*********************************************************************************************************/

static void InitHardware(void){
  SystemInit();         //系统初始化
  InitNVIC();           //初始化RCC模块
  InitRCC();            //初始化NVIC模块
  InitUART1(115200);    //初始化UART1模块
  InitTimer();          //初始化Timer模块
  SysTick_Init();        //初始化SysTick模块
  LED_Init();
  
}

static void InitSoftware(void){
  FreeRTOS_Task_Init();
}



static void Proc2msTask(void){
  if(Get2msFlag()){
    LED = ~LED;
    Clr2msFlag();
  }
}

static void Proc1secTask(void){
  if(Get1SecFlag()){
    
    Clr1SecFlag();
  }
}

/*********************************************************************************************************
* API 函数实现
*********************************************************************************************************/

int main(){
  InitHardware();
  InitSoftware();
  LCD_Clear(BLACK);

  while(1){
    
    
    Proc2msTask();
    Proc1secTask();
    
  }
}

 







